/* source keypos definitions */
// #include "../zmk-nodefree-config/keypos_def/keypos_42keys.h"
#include "zmk-helpers/key-labels/42.h"

#define NAV 1
#define FN 2

/* map Corne's extra keys */
#define X_LT &kp RC(RG(Q))
#define X_LM &kp ESC
#define X_LB &kp (LG(D))

#define X_RT &none
#define X_RM &tog NAV
#define X_RB &kp LG(LS(LA(R)))

/* activate bluetooth */
#define CONFIG_WIRELESS 1

/* source the main keymap */
#include "base.keymap"
